## conf/bblayers.conf
```bitbake
# POKY_BBLAYERS_CONF_VERSION is increased each time build/conf/bblayers.conf
# changes incompatibly
POKY_BBLAYERS_CONF_VERSION = "2"

BBPATH = "${TOPDIR}"
BBFILES ?= ""

BBLAYERS ?= " \
  ${TOPDIR}/submodules/poky/meta \
  ${TOPDIR}/submodules/poky/meta-poky \
  ${TOPDIR}/submodules/poky/meta-yocto-bsp \
  ${TOPDIR}/submodules/meta-custom \
  "
```

## layers/meta-custom/conf/layer.conf
```bitbake
# We have a conf and classes directory, add to BBPATH
BBPATH .= ":${LAYERDIR}"

# We have recipes-* directories, add to BBFILES
BBFILES += "${LAYERDIR}/recipes-*/*/*.bb \
            ${LAYERDIR}/recipes-*/*/*.bbappend"

BBFILE_COLLECTIONS += "meta-custom"
BBFILE_PATTERN_meta-custom = "^${LAYERDIR}/"
BBFILE_PRIORITY_meta-custom = "9"

LAYERDEPENDS_meta-custom = "core"
LAYERSERIES_COMPAT_meta-custom = "mickledore"

DISTRO_FEATURES = "acl debuginfod ipv4 xattr vfat seccomp \
ptest multiarch systemd sysvinit ldconfig virtualization ipv6"

DISTRO_FEATURES_NATIVE := "x11 seccomp ipv6 xattr virtualization"

DISTRO_FEATURES_BACKFULL_CONSIDERED = "sysvinit"
VIRTUAL-RUNTIME_init_manager = "systemd"

PACKAGECONFIG:remove:pn-systemd = "networkd"
PACKAGECONFIG:remove:pn-systemd = "timedated"
PACKAGECONFIG:remove:pn-systemd = "timesyncd"

PREFERRED_RPROVIDER_util-linux-nsenter-native = "util-linux-native"
PREFERRED_RPROVIDER_virtual-runc-native = "runc-opencontainers-native"
PREFERRED_RPROVIDER_iptables-module-xt-standard-native = "iptables-native"

PREFERRED_PROVIDER_virtual/kernel ?= "linux-dummy"
```

## submodules/meta-custom/conf/layer.conf
```bitbake
# We have a conf and classes directory, add to BBPATH
BBPATH .= ":${LAYERDIR}"

# We have recipes-* directories, add to BBFILES
BBFILES += "${LAYERDIR}/recipes-*/*/*.bb \
            ${LAYERDIR}/recipes-*/*/*.bbappend"

BBFILE_COLLECTIONS += "meta-custom"
BBFILE_PATTERN_meta-custom = "^${LAYERDIR}/"
BBFILE_PRIORITY_meta-custom = "6"

LAYERDEPENDS_meta-custom = "core"
LAYERSERIES_COMPAT_meta-custom = "thud"

DISTRO_FEATURES_append = " systemd"
DISTRO_FEATURES_BACKFULL_CONSIDERED = "sysvinit"
VIRTUAL-RUNTIME_init_manager = "systemd"

PACKAGECONFIG_remove_pn-systemd = "networkd"
PACKAGECONFIG_remove_pn-systemd = "timedated"
PACKAGECONFIG_remove_pn-systemd = "timesyncd"
```
